## Kconfig
```kconfig
#
# For a description of the syntax of this configuration file,
# see Documentation/kbuild/kconfig-language.txt.
#
mainmenu "Linux/$ARCH $KERNELVERSION Kernel Configuration"

config SRCARCH
	string
	option env="SRCARCH"


menu "PASR Project"

config DEBUG_PAGE_ALLOC_ORDER
	bool "List # of mem allocation for each order"
	default n

config SORT_FREELIST
	bool "Sort the free list"
	default n

config PRINT_BUDDY_FREELIST
	bool "print the free list"
	default n

config DISABLE_PAGE_MOBILITY
	bool "disable grouping page by mobility"
	default n

config MARK_PAGE_CACHE_ALLOC
	bool "make page allocated for page cache visible"
	default n

config PASR_HYPERCALL
	bool "use hyper call to trace memory allocation and free request"
	default n

config PASR_STUPID
	bool "stupid modifications"
	default n

config MM_OPT
	bool "memory management opt"
	default n
config GET_ORDER_0_LOG
	bool "call dump_stack() when order is 0"
	default n

config FORCE_MAX_ZONEORDER
	int "MAX_ZONEORDER"
	default 15

endmenu

source "arch/$SRCARCH/Kconfig"
```
